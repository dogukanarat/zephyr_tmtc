## Kconfig
```kconfig
menuconfig TMTC
    bool "Custom TMTC api"
    help
    Enable YourCo TMTC api

if TMTC
    config TMTC_LOG_LEVEL
        int "TMTC api log level"
        default 2
        help
            Set the log level for the DANP module:
            0: Off
            1: Error
            2: Warning
            3: Info
            4: Debug
endif # TMTC
```
